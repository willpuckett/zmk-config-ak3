## config/boards/shields/ak3/Kconfig.defconfig
```kconfig
if SHIELD_AK3
	config ZMK_KEYBOARD_NAME
		default "ak3"

	config LAYOUT
		int "Keyboard layout"
		default 1

endif
```

## config/boards/shields/ak3/Kconfig.shield
```kconfig
config SHIELD_AK3_USB
	def_bool $(shields_list_contains,ak3_usb)

config SHIELD_AK3_NO_USB
    def_bool $(shields_list_contains,ak3_no_usb)

config SHIELD_AK3_ENGRAMMER_USB
    def_bool $(shields_list_contains,ak3_engrammer_usb)

config SHIELD_AK3_ENGRAMMER_NO_USB
    def_bool $(shields_list_contains,ak3_engrammer_no_usb)
	
```

## config/boards/shields/piano/Kconfig.defconfig
```kconfig
# Copyright (c) 2020 The ZMK Contributors
# SPDX-License-Identifier: MIT

config ZMK_BLE
	default y

config ZMK_USB
	default y

if SHIELD_RETROFIT

config ZMK_KEYBOARD_NAME
	default "retrofit"

endif


if SHIELD_PIANO

config ZMK_KEYBOARD_NAME
	default "piano"

endif
```

## config/boards/shields/piano/Kconfig.shield
```kconfig
# Copyright (c) 2020 The ZMK Contributors
# SPDX-License-Identifier: MIT
	
config SHIELD_RETROFIT
	def_bool $(shields_list_contains,retrofit)


config SHIELD_PIANO
	def_bool $(shields_list_contains,piano)
```

## config/west.yml
```yaml
#    - name: zmk
#      remote: zmkfirmware
#      revision: main
#      import: app/west.yml
manifest:
  remotes:
    - name: zmkfirmware
      url-base: https://github.com/zmkfirmware
    - name: benvallack
      url-base: https://github.com/benvallack
  projects:
   - name: zmk
     remote: benvallack
     revision: repeatrollfix-tapdance-macro-mouse-dongle
     import: app/west.yml
  self:
    path: config
```
